// generated by ArduinoML

int BUTTON1 = 9;
int BUTTON2 = 10;
int BUZZER = 12;

void setup() {
	pinMode(BUTTON1, INPUT);
	pinMode(BUTTON2, INPUT);
	pinMode(BUZZER, OUTPUT);
}

int state = LOW; int prev = HIGH;
long time = 0; long debounce = 200;

void state_off() {
	digitalWrite(BUZZER, LOW);
	boolean guard = millis() - time > debounce;
	if (digitalRead(BUTTON1) == HIGH && guard) {
		time = millis(); state_button1_pressed();
	} else {
		state_off();
	}
}

void state_button1_pressed() {
	digitalWrite(BUZZER, LOW);
	boolean guard = millis() - time > debounce;
	if (digitalRead(BUTTON2) == HIGH && guard) {
		time = millis(); state_both_pressed();
	} else {
		state_button1_pressed();
	}
}

void state_both_pressed() {
	digitalWrite(BUZZER, HIGH);
	boolean guard = millis() - time > debounce;
	if (digitalRead(BUTTON1) == LOW && guard) {
		time = millis(); state_off();
	} else {
		state_both_pressed();
	}
}

void loop() { state_off(); }