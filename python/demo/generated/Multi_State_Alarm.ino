// generated by ArduinoML

int BUTTON = 9;
int LED = 11;
int BUZZER = 12;

void setup() {
	pinMode(BUTTON, INPUT);
	pinMode(LED, OUTPUT);
	pinMode(BUZZER, OUTPUT);
}

int state = LOW; int prev = HIGH;
long time = 0; long debounce = 200;

void state_off() {
	digitalWrite(LED, LOW);
	digitalWrite(BUZZER, LOW);
	boolean guard = millis() - time > debounce;
	if (digitalRead(BUTTON) == HIGH && guard) {
		time = millis(); state_buzzing();
	} else {
		state_off();
	}
}

void state_buzzing() {
	digitalWrite(LED, LOW);
	digitalWrite(BUZZER, HIGH);
	boolean guard = millis() - time > debounce;
	if (digitalRead(BUTTON) == HIGH && guard) {
		time = millis(); state_led_on();
	} else {
		state_buzzing();
	}
}

void state_led_on() {
	digitalWrite(LED, HIGH);
	digitalWrite(BUZZER, LOW);
	boolean guard = millis() - time > debounce;
	if (digitalRead(BUTTON) == HIGH && guard) {
		time = millis(); state_off();
	} else {
		state_led_on();
	}
}

void loop() { state_off(); }