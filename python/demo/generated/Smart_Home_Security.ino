// generated by ArduinoML

int ARM_BUTTON = 8;
int DOOR_SENSOR = 9;
int MOTION_DETECTOR = 1;
int STATUS_LED = 10;
int ALARM_LED = 11;
int SIREN = 12;

void setup() {
	pinMode(ARM_BUTTON, INPUT);
	pinMode(DOOR_SENSOR, INPUT);
	pinMode(MOTION_DETECTOR, INPUT);
	pinMode(STATUS_LED, OUTPUT);
	pinMode(ALARM_LED, OUTPUT);
	pinMode(SIREN, OUTPUT);
}

int state = LOW; int prev = HIGH;
long time = 0; long debounce = 200;

void state_disarmed() {
	digitalWrite(STATUS_LED, LOW);
	digitalWrite(ALARM_LED, LOW);
	digitalWrite(SIREN, LOW);
	boolean guard = millis() - time > debounce;
	if (digitalRead(ARM_BUTTON) == HIGH && guard) {
		time = millis(); state_armed();
	} else {
		state_disarmed();
	}
}

void state_armed() {
	digitalWrite(STATUS_LED, HIGH);
	digitalWrite(ALARM_LED, LOW);
	digitalWrite(SIREN, LOW);
	boolean guard = millis() - time > debounce;
	if (digitalRead(DOOR_SENSOR) == HIGH && guard) {
		time = millis(); state_door_open();
	} else {
		state_armed();
	}
}

void state_door_open() {
	digitalWrite(STATUS_LED, HIGH);
	digitalWrite(ALARM_LED, LOW);
	digitalWrite(SIREN, LOW);
	boolean guard = millis() - time > debounce;
	if (digitalRead(MOTION_DETECTOR) == HIGH && guard) {
		time = millis(); state_intrusion_detected();
	} else {
		state_door_open();
	}
}

void state_intrusion_detected() {
	digitalWrite(STATUS_LED, HIGH);
	digitalWrite(ALARM_LED, HIGH);
	digitalWrite(SIREN, HIGH);
	boolean guard = millis() - time > debounce;
	if (digitalRead(ARM_BUTTON) == HIGH && guard) {
		time = millis(); state_disarmed();
	} else {
		state_intrusion_detected();
	}
}

void loop() { state_disarmed(); }